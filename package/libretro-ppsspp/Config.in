## package/libretro-ppsspp/Config.in
```kconfig
config BR2_PACKAGE_LIBRETRO_PPSSPP
	bool "libretro-ppsspp"
	depends on BR2_PACKAGE_SDL2
	depends on BR2_PACKAGE_ZLIB
	depends on BR2_PACKAGE_FFMPEG_SWSCALE
	help
	  A  PSP emulator
```

## package/libretro-quicknes/Config.in
```kconfig
config BR2_PACKAGE_LIBRETRO_QUICKNES
	bool "libretro-quicknes"
	depends on BR2_PACKAGE_RETROARCH
	depends on BR2_INSTALL_LIBSTDCPP
	help
	 placeholder

comment "QuickNES requires a toolchain w/ C++"
	depends on !BR2_INSTALL_LIBSTDCPP
```

## package/mgba/Config.in
```kconfig
config BR2_PACKAGE_MGBA
	bool "mgba"
	depends on BR2_INSTALL_LIBSTDCPP
	help
	  A GBA emulator core for ARM.

	  http://www.libretro.com

comment "MGBA needs a toolchain w/ C++"
	depends on !BR2_INSTALL_LIBSTDCPP
```

## package/rdaemon/Config.in
```kconfig
config BR2_PACKAGE_RDAEMON
	bool "Rdaemon"
	help
	  The handler for background key presses for Ragnarok OS
	  
	  https://github.com/R-ARM/Ragnarok
```

## package/retroarch-assets/Config.in
```kconfig
config BR2_PACKAGE_RETROARCH_ASSETS
	bool "Retroarch Assets"
	depends on BR2_PACKAGE_RETROARCH
	help
	  retroarch assets lmfao
```

## package/rinputer/Config.in
```kconfig
config BR2_PACKAGE_RINPUTER
	bool "Rinputer"
	help
	  The input daemon for Ragnarok OS
	  
	  https://github.com/R-ARM/Ragnarok
```

## package/rmenu/Config.in
```kconfig
config BR2_PACKAGE_RMENU
	bool "Rmenu"
	help
	  The menu for Ragnarok OS
	  
	  https://github.com/R-ARM/Ragnarok
```

## package/rplayer/Config.in
```kconfig
config BR2_PACKAGE_RPLAYER
	bool "Rplayer"
	help
	  The input daemon for Ragnarok OS
	  
	  https://github.com/R-ARM/Ragnarok
```

## package/rtoybox/Config.in
```kconfig
config BR2_PACKAGE_RTOYBOX
	bool "Rtoybox, all programs"
	help
	  Everything libragnarok for Ragnarok OS
```

## package/stkassets/Config.in
```kconfig
config BR2_PACKAGE_STKASSETS
	bool "Supertuxkart Assets"
	help
	  AAAAAAAAAAAAAAAAAA
```
